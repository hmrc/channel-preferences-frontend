## govuk-tax/conf/local.conf
```bitbake
# Play configuration for the local production environment
# ==============================================

include "application.conf"

govuk-tax {

    Prod {
        metrics {
            graphite {
                host = graphite
                port = 2003
                prefix = play.tax.
                enabled = false
            }
        }

        externalLinks {
            businessTax.manageTaxes.servicesHome="https://secure.hmce.gov.uk/ecom/login/index.html"
            businessTax.registration.otherWays="http://www.hmrc.gov.uk/online/new.htm#2"
            businessTax.manageTaxes.ncts="https://customs.hmrc.gov.uk/nctsPortalWebApp/ncts.portal?_nfpb=true&pageLabel=httpssIPageOnlineServicesAppNCTS_Home"
            businessTax.manageTaxes.rcsl="https://customs.hmrc.gov.uk/rcsl/httpssl/Home.do"
            businessTax.manageTaxes.ecsl="https://customs.hmrc.gov.uk/ecsl/httpssl/start.do"
        }

        portal {
            ssoUrl="http://localhost:8080/portal/ssoin"
            destinationRoot="http://localhost:8080/portal"
            domainWhiteList=[
                localhost
            ]
            loggedOutUrl="http://localhost:8080/portal/loggedout"
            ssoInLogoutUrl="http://localhost:8080/portal/ssoin/logout?host=http://localhost:9000"
            destinationPath.saViewAccountDetails="http://localhost:8080/portal/self-assessment/<affinitygroup>/<utr>/account"
            destinationPath.saFileAReturn="http://localhost:8080/portal/self-assessment-file/<year>/<affinitygroup>/<utr>/return"
            destinationPath.home="http://localhost:8080/portal/home"
            destinationPath.vatAccountDetails="http://localhost:8080/portal/home"
            destinationPath.vatFileAReturn="http://localhost:8080/portal/home"
            destinationPath.vatHelpDesk="http://localhost:8080/portal/home"
            destinationPath.vatOnlineAccount="http://localhost:8080/portal/vat/trader/<vrn>/directdebit"
            destinationPath.ctAccountDetails="http://localhost:8080/portal/corporation-tax/org/<ctutr>/account/balanceperiods"
            destinationPath.btDirectDebits="http://localhost:8080/portal/directdebits/welcome"
            destinationPath.ctFileAReturn="http://localhost:8080/portal/corporation-tax/org/<ctutr>"
            destinationPath.otherServicesEnrolment="http://localhost:8080/portal/home/services/enroll"
            destinationPath.otherServices="http://localhost:8080/portal/other-services"
            destinationPath.servicesDeEnrolment="http://localhost:8080/portal/home/removeservices"
            destinationPath.businessRegistration="http://localhost:8080/portal/business-registration/introduction"
            destinationPath.manageTaxes.servicesHome="http://localhost:8080/home/services"
            destinationPath.manageTaxes.emcs="http://localhost:8080/portal/emcs"
            destinationPath.manageTaxes.ics="http://localhost:8080/portal/ics"
            destinationPath.manageTaxes.machinegames="http://localhost:8080/portal/machine-games-duty"
            destinationPath.manageTaxes.nova="http://localhost:8080/portal/nova"
            destinationPath.manageTaxes.euvat="http://localhost:8080/portal/eu-vat"
        }

        platform {
            frontend {
                protocol=http
                host=localhost
                port=9000
            }
        }

        services {
            timeout = 5 seconds

            delay-response = 2 seconds

            protocol=http

            auth {
                host=localhost
                port=8500
            }

            ct {
                host=localhost
                port=8647
            }

            datastream {
                host=localhost
                port=8100
                enabled=true
                traceRequests=true
            }

            government-gateway {
                host=localhost
                port=8570
            }

            keystore {
                host=localhost
                port=8400
            }

            paye {
                host=localhost
                port=8600
            }

            matching {
                host=localhost
                port=8520
            }

            saml {
                host=localhost
                port=8080
            }

            sa {
                host=localhost
                port=8900
            }

            txqueue {
                host=localhost
                port=8700
            }

            vat {
                host=localhost
                port=8880
            }

            agent {
                 host=localhost
                 port=8420
            }

            epaye {
                 host=localhost
                 port=8090
            }
        }
    }
}
```

## sa-prefs/conf/local.conf
```bitbake
# Play configuration for the local production environment
# ==============================================

include "application.conf"

sa-prefs {

    Prod {
        platform {
            frontend {
                protocol=http
                host=localhost
                port=9000
            }
        }

        services {
            timeout = 5 seconds

            delay-response = 2 seconds

            protocol=http

            preferences {
                host=localhost
                port=8025
            }
        }

        portal {
            tokenTimeout=240
            redirectDomainWhiteList=[
                localhost
            ]
            destinationRoot="http://localhost:8080/portal"
            destinationPath.home="/home"
        }
    }
}
```
